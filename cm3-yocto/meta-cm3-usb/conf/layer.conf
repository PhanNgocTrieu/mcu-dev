## meta-connectivity/conf/layer.conf
```bitbake
BBPATH .= ":${LAYERDIR}"
BBFILES += "${LAYERDIR}/recipes-*/*/*.bb \
            ${LAYERDIR}/recipes-*/*/*.bbappend"

BBFILE_COLLECTIONS += "connectivity"
BBFILE_PATTERN_connectivity = "^${LAYERDIR}/"
BBFILE_PRIORITY_connectivity = "10"

LAYERDEPENDS_connectivity = "core raspberrypi"
LAYERSERIES_COMPAT_connectivity = "scarthgap"
```
